## firmware/smars_esp32c3/crates/smars_esp32c3/sdkconfig.defaults
```kconfig
# ---- 线程/任务栈（Rust 相比 C 需要更大栈）----
CONFIG_ESP_MAIN_TASK_STACK_SIZE=8192
CONFIG_PTHREAD_TASK_STACK_SIZE_DEFAULT=4096
CONFIG_ESP_SYSTEM_EVENT_TASK_STACK_SIZE=4096

# ---- WiFi softAP（esp-idf-svc 的 ap netif 依赖此选项编译）----
CONFIG_ESP_WIFI_SOFTAP_SUPPORT=y

# ---- 内置 HTTP server（浏览器请求头（UA/Cookie 等）较长）----
# esp-idf-svc http::server 文档建议浏览器场景设为 1024
CONFIG_HTTPD_MAX_REQ_HDR_LEN=1024
```
